## CMakeLists.txt
```
#
# Copyright (c) 2018 Nordic Semiconductor
#
# SPDX-License-Identifier: LicenseRef-BSD-5-Clause-Nordic
#

cmake_minimum_required(VERSION 3.8.2)

include(../../cmake/boilerplate.cmake)
include($ENV{ZEPHYR_BASE}/cmake/app/boilerplate.cmake NO_POLICY_SCOPE)

project(gridnode)

target_include_directories(app PRIVATE include)
target_sources(app PRIVATE src/main.c)
target_sources(app PRIVATE src/led.c)
target_sources(app PRIVATE src/controller.c)
target_sources(app PRIVATE src/walltime.c)
target_sources(app PRIVATE src/sntp_raw.c)
target_sources(app PRIVATE src/estimator.c)
target_sources(app PRIVATE src/sensor.c)
```

## prj.conf
```kconfig
# General config
CONFIG_TEST_RANDOM_GENERATOR=y

# Networking
CONFIG_NETWORKING=y
CONFIG_NET_SOCKETS_OFFLOAD=y
CONFIG_NET_SOCKETS=y
CONFIG_NET_SOCKETS_POSIX_NAMES=y

# LTE link control
CONFIG_LTE_LINK_CONTROL=y
CONFIG_LTE_AUTO_INIT_AND_CONNECT=n

# BSD library
CONFIG_BSD_LIBRARY=y

# AT Host
CONFIG_UART_INTERRUPT_DRIVEN=y
CONFIG_AT_HOST_LIBRARY=y

# MQTT
CONFIG_MQTT_LIB=y
CONFIG_MQTT_LIB_TLS=n

# Appliaction
CONFIG_MQTT_PUB_TOPIC="f3gs345t/pubtopic"
CONFIG_MQTT_SUB_TOPIC="f3gs345t/subtopic"
CONFIG_MQTT_CLIENT_ID="nrf91-f3gs345t"
CONFIG_MQTT_BROKER_HOSTNAME="mqtt.newtonseple.eu"
CONFIG_MQTT_BROKER_PORT=1883

# Main thread
CONFIG_MAIN_THREAD_PRIORITY=7
CONFIG_MAIN_STACK_SIZE=4096

CONFIG_HEAP_MEM_POOL_SIZE=1024

# GPIO (for LED indication)
CONFIG_GPIO=y

# POLL (for consolidating timer and MQTT events)
CONFIG_POLL=y
```

## src/main.c
```c
/*
 * Copyright (c) 2018 Nordic Semiconductor ASA
 *
 * SPDX-License-Identifier: LicenseRef-BSD-5-Clause-Nordic
 */

#include <zephyr.h>
#include <stdio.h>
#include <uart.h>
#include <string.h>


#include <net/mqtt.h>
#include <net/socket.h>
#include <lte_lc.h>

#include "sntp_raw.h"
#include "walltime.h"
#include "led.h"
#include "controller.h"
#include "sensor.h"

/* Buffers for MQTT client. */
static u8_t rx_buffer[CONFIG_MQTT_MESSAGE_BUFFER_SIZE];
static u8_t tx_buffer[CONFIG_MQTT_MESSAGE_BUFFER_SIZE];
static u8_t payload_buf[CONFIG_MQTT_PAYLOAD_BUFFER_SIZE];

/* The mqtt client struct */
static struct mqtt_client client;

/* MQTT Broker details. */
static struct sockaddr_storage broker;

/* Connected flag */
static bool connected;

/* File descriptor */
static struct pollfd fds;

/* Kernel event for thread communication */
struct k_poll_signal mqtt_event_signal;
struct k_poll_signal mqtt_ready_signal;
struct k_poll_signal periodic_event_signal;

/* Timer for periodic send actions */
void periodic_isr (struct k_timer *timer_id); // Fwd declaration needed
K_TIMER_DEFINE(periodic_id, periodic_isr, NULL);

#if defined(CONFIG_BSD_LIBRARY)

/**@brief Recoverable BSD library error. */
void bsd_recoverable_error_handler(uint32_t err)
{
	printk("bsdlib recoverable error: %u\n", err);
}

/**@brief Irrecoverable BSD library error. */
void bsd_irrecoverable_error_handler(uint32_t err)
{
	printk("bsdlib irrecoverable error: %u\n", err);

	__ASSERT_NO_MSG(false);
}

#endif /* defined(CONFIG_BSD_LIBRARY) */

/**@brief Function to print strings without null-termination
 */
static void data_print(u8_t *prefix, u8_t *data, size_t len)
{
	char buf[len + 1];

	memcpy(buf, data, len);
	buf[len] = 0;
	printk("%s%s\n", prefix, buf);
}

/**@brief Function to publish data on the configured topic
 */
static int data_publish(struct mqtt_client *c, enum mqtt_qos qos,
	u8_t *data, size_t len)
{
	struct mqtt_publish_param param;

	param.message.topic.qos = qos;
	param.message.topic.topic.utf8 = CONFIG_MQTT_PUB_TOPIC;
	param.message.topic.topic.size = strlen(CONFIG_MQTT_PUB_TOPIC);
	param.message.payload.data = data;
	param.message.payload.len = len;
	param.message_id = sys_rand32_get();
	param.dup_flag = 0;
	param.retain_flag = 0;

	data_print("Publishing: ", data, len);
	printk("to topic: %s len: %u\n",
		CONFIG_MQTT_PUB_TOPIC,
		(unsigned int)strlen(CONFIG_MQTT_PUB_TOPIC));

	return mqtt_publish(c, &param);
}

/**@brief Function to subscribe to the configured topic
 */
static int subscribe(void)
{
	struct mqtt_topic subscribe_topic = {
		.topic = {
			.utf8 = CONFIG_MQTT_SUB_TOPIC,
			.size = strlen(CONFIG_MQTT_SUB_TOPIC)
		},
		.qos = MQTT_QOS_1_AT_LEAST_ONCE
	};

	const struct mqtt_subscription_list subscription_list = {
		.list = &subscribe_topic,
		.list_count = 1,
		.message_id = 1234
	};

	printk("Subscribing to: %s len %u\n", CONFIG_MQTT_SUB_TOPIC,
		(unsigned int)strlen(CONFIG_MQTT_SUB_TOPIC));

	return mqtt_subscribe(&client, &subscription_list);
}

/**@brief Function to read the published payload.
 */
static int publish_get_payload(struct mqtt_client *c, size_t length)
{
	u8_t *buf = payload_buf;
	u8_t *end = buf + length;

	if (length > sizeof(payload_buf)) {
		return -EMSGSIZE;
	}

	while (buf < end) {
		int ret = mqtt_read_publish_payload(c, buf, end - buf);

		if (ret < 0) {
			int err;

			if (ret != -EAGAIN) {
				return ret;
			}

			printk("mqtt_read_publish_payload: EAGAIN\n");

			err = poll(&fds, 1, K_SECONDS(CONFIG_MQTT_KEEPALIVE));
			if (err > 0 && (fds.revents & POLLIN) == POLLIN) {
				continue;
			} else {
				return -EIO;
			}
		}

		if (ret == 0) {
			return -EIO;
		}

		buf += ret;
	}

	return 0;
}

/**@brief MQTT client event handler
 */
void mqtt_evt_handler(struct mqtt_client *const c,
		      const struct mqtt_evt *evt)
{
	int err;
	leds_write(0x4,0x4);
	switch (evt->type) {
	case MQTT_EVT_CONNACK:
		if (evt->result != 0) {
			printk("MQTT connect failed %d\n", evt->result);
			break;
		}

		connected = true;
		printk("[%s:%d] MQTT client connected!\n", __func__, __LINE__);
		subscribe();
		break;

	case MQTT_EVT_DISCONNECT:
		printk("[%s:%d] MQTT client disconnected %d\n", __func__,
		       __LINE__, evt->result);

		connected = false;
		break;

	case MQTT_EVT_PUBLISH: {
		const struct mqtt_publish_param *p = &evt->param.publish;

		printk("[%s:%d] MQTT PUBLISH result=%d len=%d\n", __func__,
		       __LINE__, evt->result, p->message.payload.len);
		err = publish_get_payload(c, p->message.payload.len);
		if (err >= 0) {
			data_print("Received: ", payload_buf,
				p->message.payload.len);
			handle_message(payload_buf, p->message.payload.len);
		} else {
			printk("mqtt_read_publish_payload: Failed! %d\n", err);
			printk("Disconnecting MQTT client...\n");

			err = mqtt_disconnect(c);
			if (err) {
				printk("Could not disconnect: %d\n", err);
			}
		}
	} break;

	case MQTT_EVT_PUBACK:
		if (evt->result != 0) {
			printk("MQTT PUBACK error %d\n", evt->result);
			break;
		}

		printk("[%s:%d] PUBACK packet id: %u\n", __func__, __LINE__,
				evt->param.puback.message_id);
		break;

	case MQTT_EVT_SUBACK:
		if (evt->result != 0) {
			printk("MQTT SUBACK error %d\n", evt->result);
			break;
		}

		printk("[%s:%d] SUBACK packet id: %u\n", __func__, __LINE__,
				evt->param.suback.message_id);
		break;

	default:
		printk("[%s:%d] default: %d\n", __func__, __LINE__,
				evt->type);
		break;
	}
	leds_write(0x4,0x0);
}

/**@brief Resolves the configured hostname and
 * initializes the MQTT broker structure
 */
static void broker_init(void)
{
	int err;
	struct addrinfo *result;
	struct addrinfo *addr;
	struct addrinfo hints = {
		.ai_family = AF_INET,
		.ai_socktype = SOCK_STREAM
	};

	err = getaddrinfo(CONFIG_MQTT_BROKER_HOSTNAME, NULL, &hints, &result);
	if (err) {
		printk("ERROR: getaddrinfo failed %d\n", err);

		return;
	}

	addr = result;
	err = -ENOENT;

	/* Look for address of the broker. */
	while (addr != NULL) {
		/* IPv4 Address. */
		if (addr->ai_addrlen == sizeof(struct sockaddr_in)) {
			struct sockaddr_in *broker4 =
				((struct sockaddr_in *)&broker);

			broker4->sin_addr.s_addr =
				((struct sockaddr_in *)addr->ai_addr)
				->sin_addr.s_addr;
			broker4->sin_family = AF_INET;
			broker4->sin_port = htons(CONFIG_MQTT_BROKER_PORT);
			printk("IPv4 Address found 0x%08x\n",
				broker4->sin_addr.s_addr);
			break;
		} else {
			printk("ai_addrlen = %u should be %u or %u\n",
				(unsigned int)addr->ai_addrlen,
				(unsigned int)sizeof(struct sockaddr_in),
				(unsigned int)sizeof(struct sockaddr_in6));
		}

		addr = addr->ai_next;
		break;
	}

	/* Free the address. */
	freeaddrinfo(result);
}

/**@brief Initialize the MQTT client structure
 */
static void client_init(struct mqtt_client *client)
{
	mqtt_client_init(client);

	broker_init();

	/* MQTT client configuration */
	client->broker = &broker;
	client->evt_cb = mqtt_evt_handler;
	client->client_id.utf8 = (u8_t *)CONFIG_MQTT_CLIENT_ID;
	client->client_id.size = strlen(CONFIG_MQTT_CLIENT_ID);
	client->password = NULL;
	client->user_name = NULL;
	client->protocol_version = MQTT_VERSION_3_1_1;

	/* MQTT buffers configuration */
	client->rx_buf = rx_buffer;
	client->rx_buf_size = sizeof(rx_buffer);
	client->tx_buf = tx_buffer;
	client->tx_buf_size = sizeof(tx_buffer);

	/* MQTT transport configuration */
	client->transport.type = MQTT_TRANSPORT_NON_SECURE;
}

/**@brief Initialize the file descriptor structure used by poll.
 */
static int fds_init(struct mqtt_client *c)
{
	if (c->transport.type == MQTT_TRANSPORT_NON_SECURE) {
		fds.fd = c->transport.tcp.sock;
	} else {
#if defined(CONFIG_MQTT_LIB_TLS)
		fds.fd = c->transport.tls.sock;
#else
		return -ENOTSUP;
#endif
	}

	fds.events = POLLIN;

	return 0;
}

/**@brief Configures modem to provide LTE link. Blocks until link is
 * successfully established.
 */
static void modem_configure(void)
{
#if defined(CONFIG_LTE_LINK_CONTROL)
	if (IS_ENABLED(CONFIG_LTE_AUTO_INIT_AND_CONNECT)) {
		/* Do nothing, modem is already turned on
		 * and connected.
		 */
	} else {
		int err;

		printk("LTE Link Connecting ...\n");
		err = lte_lc_init_and_connect();
		__ASSERT(err == 0, "LTE link could not be established.");
		printk("LTE Link Connected!\n");
	}
#endif
}

void main(void)
{
	int err;

	printk("The MQTT simple sample started\n");
	leds_init();
	leds_write(0xF,0xF);
	modem_configure();
	
	leds_write(0xF,0x0);

	client_init(&client);

	err = mqtt_connect(&client);
	if (err != 0) {
		printk("ERROR: mqtt_connect %d\n", err);
		return;
	}

	err = fds_init(&client);
	if (err != 0) {
		printk("ERROR: fds_init %d\n", err);
		return;
	}


	// Signals waking up the event handler
	k_poll_signal_init(&mqtt_event_signal);
	k_poll_signal_init(&periodic_event_signal);
	struct k_poll_event events[2] = {
        K_POLL_EVENT_INITIALIZER(K_POLL_TYPE_SIGNAL,
                                 K_POLL_MODE_NOTIFY_ONLY,
                                 &mqtt_event_signal),
		K_POLL_EVENT_INITIALIZER(K_POLL_TYPE_SIGNAL,
                                 K_POLL_MODE_NOTIFY_ONLY,
                                 &periodic_event_signal),
    };

	walltime_init();

	k_timer_start(&periodic_id, K_MSEC(2500), K_MSEC(2500));
	k_poll_signal_raise(&mqtt_ready_signal, 0);
	while (1) {
		leds_write(0x1,0x1);
		k_poll(events, 2, K_FOREVER);
		leds_write(0x1,0x0);

		// Handle periodic sending
		if (events[1].signal->signaled) {
			events[1].signal->signaled = 0;
			events[1].state = K_POLL_STATE_NOT_READY;
			
			err = sensor_build_payload(payload_buf);
			if (err < 0) {
				break;
			}

			data_publish(&client, MQTT_QOS_1_AT_LEAST_ONCE,
				payload_buf, strlen(payload_buf));
		}

		//Do MQTT operations
		if (events[0].signal->signaled) {
			events[0].signal->signaled = 0;
			events[0].state = K_POLL_STATE_NOT_READY;
			err = events[0].signal->result;
			if (err < 0) {
				printk("ERROR: poll %d\n", err);
				break;
			}

			// Connection maintainance
			err = mqtt_live(&client);
			if (err != 0) {
				printk("ERROR: mqtt_live %d\n", err);
				break;
			}
			
			// Handle MQTT socket events
			if ((fds.revents & POLLIN) == POLLIN) {
				err = mqtt_input(&client);
				if (err != 0) {
					printk("ERROR: mqtt_input %d\n", err);
					break;
				}
			}
			if ((fds.revents & POLLERR) == POLLERR) {
				printk("POLLERR\n");
				break;
			}
			if ((fds.revents & POLLNVAL) == POLLNVAL) {
				printk("POLLNVAL\n");
				break;
			}
		}
		
	}

	printk("Disconnecting MQTT client...\n");

	err = mqtt_disconnect(&client);
	if (err) {
		printk("Could not disconnect MQTT client. Error: %d\n", err);
	}

}

void periodic_isr (struct k_timer *timer_id){
	k_poll_signal_raise(&periodic_event_signal, 0);
}

void mqtt_poller_thread(void){
	k_poll_signal_init(&mqtt_ready_signal);
	int err;
	struct k_poll_event events[1] = {
        K_POLL_EVENT_INITIALIZER(K_POLL_TYPE_SIGNAL,
                                 K_POLL_MODE_NOTIFY_ONLY,
                                 &mqtt_ready_signal),
    };
	printk("mqtt_poller_thread waiting for go\n");
	k_poll(events, 1, K_FOREVER);
	printk("mqtt_poller_thread got go\n");
	while(1){
		leds_write(0x2,0x2);
		
		err = poll(&fds, 1, K_SECONDS(CONFIG_MQTT_KEEPALIVE));

		leds_write(0x2,0x0);
		printk("poll revents 0x%x\n", fds.revents);
		k_poll_signal_raise(&mqtt_event_signal, err);
	}

}

#define STACKSIZE 1024
#define PRIORITY 8 // Less urgent than main thread (7); BSD poll does not yield
K_THREAD_DEFINE(mqtt_poller_thread_id, STACKSIZE, mqtt_poller_thread, NULL, NULL, NULL,
		PRIORITY, 0, K_NO_WAIT);
```

## include/controller.h
```c
#ifndef __GRIDNODE_CONTROLLER__H__
#define __GRIDNODE_CONTROLLER__H__

#include <zephyr.h>
#include <stdio.h>
#include <uart.h>
#include <string.h>

void handle_message (u8_t * buf, size_t length);

#endif /* __GRIDNODE_CONTROLLER__H__ */
```

## include/estimator.h
```c
#ifndef __TINYSYNC_ESTIMATOR_H__
#define __TINYSYNC_ESTIMATOR_H__

#include <stdint.h>

typedef enum tinysync_est_ret_t{
    TINYSYNC_EST_OK = 0,
    TINYSYNC_EST_FIRST = 1,
    TINYSYNC_EST_SECOND = 2,
    TINYSYNC_EST_NONLINEAR = 3,
    TINYSYNC_EST_INVALID = 4 // Should never occur
} tinysync_est_ret_t;

typedef struct tinysync_datapoint_t{
    uint64_t t_o; // t_1 when probe was sent (+ minimum known delay until response transmission)
    uint64_t t_b; // t_2 when response was sent
    uint64_t t_r; // t_1 when response was received
} tinysync_datapoint_t;

typedef struct tinysync_constraint_t{
    uint64_t t_1; // prober clock time
    uint64_t t_2; // responder clock time
} tinysync_constraint_t;

// Line t_1 = a(t_2) + b
typedef struct tinysync_line_t{
    double a; // slope of line
    double b; // offset of line
} tinysync_line_t;

// Stored set of constraints
typedef struct tinysync_constraints_t{
    tinysync_constraint_t b_1; // Constraint B_1
    tinysync_constraint_t b_2; // Constraint B_1
    tinysync_constraint_t a_1; // Constraint A_1
    tinysync_constraint_t a_2; // Constraint A_1
} tinysync_constraints_t;

// Stored set of 4 lines between 4 constraints
typedef struct tinysync_lineset_t{
    tinysync_line_t ba; // Line B_1 A_2
    tinysync_line_t ab; // Line A_1 B_2
    tinysync_line_t aa; // Line A_1 A_2
    tinysync_line_t bb; // Line B_1 B_2
} tinysync_lineset_t;

typedef struct tinysync_est_state_t{
    tinysync_constraints_t constraints;
    tinysync_lineset_t lineset;
    uint8_t init_counter;
} tinysync_est_state_t;

void tinysync_est_state_t_initialize(tinysync_est_state_t* state);
tinysync_est_ret_t tinysync_est_etimate(tinysync_est_state_t* state, 
                                        const tinysync_datapoint_t* new_datapoint);

#endif //__TINYSYNC_ESTIMATOR_H__
```

## include/led.h
```c
#ifndef __GRIDNODE_LED__H__
#define __GRIDNODE_LED__H__

// For LED
#include <device.h>
#include <gpio.h>

// Assume same controller for all
#define LED_PORT LED0_GPIO_CONTROLLER
#define LED0 LED0_GPIO_PIN
#define LED1 LED1_GPIO_PIN
#define LED2 LED2_GPIO_PIN
#define LED3 LED3_GPIO_PIN

void leds_init();
void leds_write(uint8_t mask, uint8_t value);

#endif /* __GRIDNODE_LED__H__ */
```

## include/sensor.h
```c
#ifndef __GRIDNODE_SENSOR__H__
#define __GRIDNODE_SENSOR__H__

#include <zephyr.h>
#include <stdio.h>
#include <uart.h>
#include <string.h>

int sensor_build_payload(u8_t * payload_buf);

#endif /* __GRIDNODE_SENSOR__H__ */
```

## include/sntp_raw.h
```c
/*
 * Copyright (c) 2017 Linaro Limited
 * Copyright (c) 2019 Intel Corporation
 *
 * SPDX-License-Identifier: Apache-2.0
 */

#ifndef __GRIDNODE_SNTP__H__
#define __GRIDNODE_SNTP__H__

#include <net/socket.h>

/**
 * @brief Simple Network Time Protocol API
 * @defgroup sntp SNTP
 * @ingroup networking
 * @{
 */

/** SNTP context */
struct sntp_ctx {
	struct {
		struct pollfd fds[1];
		int nfds;
		int fd;
	} sock;

	/** Timestamp when the request was sent from client to server.
	 *  This is used to check if the originated timestamp in the server
	 *  reply matches the one in client request.
	 */
	u32_t expected_orig_ts;
};

/**
 * @brief Initialize SNTP context
 *
 * @param ctx Address of sntp context.
 * @param addr IP address of NTP/SNTP server.
 * @param addr_len IP address length of NTP/SNTP server.
 *
 * @return 0 if ok, <0 if error.
 */
int sntp_init(struct sntp_ctx *ctx, struct sockaddr *addr,
	      socklen_t addr_len);

/**
 * @brief Send SNTP request
 *
 * @param ctx Address of sntp context.
 * @param timeout Timeout of waiting for sntp response (in milliseconds).
 * @param sntp_time 64-bit NTP Tx timestamp from server.
 *
 * @return 0 if ok, <0 if error.
 */
int sntp_request(struct sntp_ctx *ctx, u32_t timeout, u64_t *sntp_time);

/**
 * @brief Release SNTP context
 *
 * @param ctx Address of sntp context.
 */
void sntp_close(struct sntp_ctx *ctx);

/**
 * @}
 */

#endif /* __GRIDNODE_SNTP__H__ */
```

## include/walltime.h
```c
#ifndef __GRIDNODE_WALLTIME__H__
#define __GRIDNODE_WALLTIME__H__

#include <stdio.h>
#include "sntp_raw.h"

int walltime_calibrate();
int walltime_get(uint64_t * t_expected, uint64_t * accuracy);
int walltime_init();

#endif /* __GRIDNODE_WALLTIME__H__ */
```

## src/controller.c
```c
#include "controller.h"
#include "led.h"
void handle_message (u8_t * buf, size_t length){
    if (length < 2) return;
    switch (buf[0]) {
        case 'L':
            switch (buf[1]) {
                case '1': 
                    leds_write(0x8,0xF);
                    break;
                case '0': 
                    leds_write(0x8,0x0);
                    break;
                default: 
                    printk("Unknown char [1]: %c\n",buf[1]);
                    break;
            }
        break;
    default: 
    printk("Unknown char [0]: %c\n",buf[0]);
    break;
    }
};
```

## src/estimator.c
```c
#include "estimator.h"

uint8_t tinysync_constraint_t_compare(tinysync_constraint_t p_1, tinysync_constraint_t p_2){
    return (p_1.t_1 == p_2.t_1 &&
            p_1.t_2 == p_2.t_2) ? 1 : 0;
}

void tinysync_est_state_t_initialize(tinysync_est_state_t * state){
    state->init_counter = 0;
}

void calculate_line(tinysync_constraint_t p_1, tinysync_constraint_t p_2, tinysync_line_t * line){
    line->a = (double)(p_2.t_1 - p_1.t_1) / (double)(p_2.t_2 - p_1.t_2);
    line->b = (double)(p_1.t_1) - line->a * (double)(p_1.t_2);
}

//estimator of linear clock drift and offset
tinysync_est_ret_t tinysync_est_etimate(tinysync_est_state_t * state, const tinysync_datapoint_t * new_datapoint){
    tinysync_est_ret_t ret = TINYSYNC_EST_OK;

    // default to keeping old points.
    // These new variables should only be written, not read, until after constraint selection
    tinysync_constraint_t b_1 = state->constraints.b_1;
    tinysync_constraint_t a_1 = state->constraints.a_1;
    tinysync_constraint_t b_2 = state->constraints.b_2;
    tinysync_constraint_t a_2 = state->constraints.a_2;

    // Convert probing datapoint to 2 points in the t_1-t_2 plane.
    tinysync_constraint_t b_3;
    tinysync_constraint_t a_3;
    b_3.t_1 = new_datapoint->t_r;
    b_3.t_2 = new_datapoint->t_b;
    a_3.t_1 = new_datapoint->t_o;
    a_3.t_2 = new_datapoint->t_b;

    // Handle constraint selection
    switch(state->init_counter){
    case 0: // First run: 1 data point, cannot estimate: directly to state and early return
        state->constraints.b_1 = b_3;
        state->constraints.a_1 = a_3;
        state->init_counter ++;
        return TINYSYNC_EST_FIRST;
    break;
    case 1: // Second run: 2 data points, can estimate
        b_2 = b_3;
        a_2 = a_3;
        state->init_counter ++;
        ret = TINYSYNC_EST_SECOND;
        break;
    default: // Algorithm initialized, normal behaviour

        // Handle new lower constraint (a_3)
        if        (a_3.t_1 < state->lineset.ba.b + state->lineset.ba.a * (double)(a_3.t_2)){
            // Lower constraint too low to be useful: do nothing
        } else if (a_3.t_1 > state->lineset.ab.b + state->lineset.ab.a * (double)(a_3.t_2)){
            // Lower constraint too high to maintain linear model: remove old constraints, add new
            b_1 = state->constraints.b_2;
            a_1 = state->constraints.a_2;
            b_2 = b_3;
            a_2 = a_3;
            ret = TINYSYNC_EST_NONLINEAR;
            break;
        } else {
            // Lower constraint useful: update a_2
            a_2 = a_3;
            if ( (!tinysync_constraint_t_compare(state->constraints.b_1,state->constraints.b_2)) && (a_3.t_1 > state->lineset.bb.b + state->lineset.bb.a * (double)(a_3.t_2)) ){
                // b_2 is better than b_1 for this lower constraint: update b_1
                b_1 = state->constraints.b_2;
            }
        }

        // Handle new upper constraint (b_3)
        if        (b_3.t_1 > state->lineset.ab.b + state->lineset.ab.a * (double)(b_3.t_2)){
            // Upper constraint too high to be useful: do nothing
        } else if (b_3.t_1 < state->lineset.ba.b + state->lineset.ba.a * (double)(b_3.t_2)){
            // Upper constraint too low to maintain linear model: remove old constraints, add new
            b_1 = state->constraints.b_2;
            a_1 = state->constraints.a_2;
            b_2 = b_3;
            a_2 = a_3;
            ret = TINYSYNC_EST_NONLINEAR;
            break;
        } else {
            // Upper constraint useful: update b_2
            b_2 = b_3;
            if ( (!tinysync_constraint_t_compare(state->constraints.a_1,state->constraints.a_2)) && (b_3.t_1 < state->lineset.aa.b + state->lineset.aa.a * (double)(b_3.t_2)) ){
                // a_2 is better than a_1 for this upper constraint: update a_1
                a_1 = state->constraints.a_2;
            }
        }
    }

    // Update stored points
    state->constraints.b_1 = b_1;
    state->constraints.a_1 = a_1;
    state->constraints.b_2 = b_2;
    state->constraints.a_2 = a_2;

    // Update lines
    calculate_line(b_1, b_2, &(state->lineset.bb));
    calculate_line(b_1, a_2, &(state->lineset.ba));
    calculate_line(a_1, b_2, &(state->lineset.ab));
    calculate_line(a_1, a_2, &(state->lineset.aa));

    return ret;
};
```

## src/led.c
```c
#include "led.h"

void leds_init(){
	// Init LED1. Assume same device.
	struct device *dev;
	dev = device_get_binding(LED_PORT);
	gpio_pin_configure(dev, LED0, GPIO_DIR_OUT);
	gpio_pin_configure(dev, LED1, GPIO_DIR_OUT);
	gpio_pin_configure(dev, LED2, GPIO_DIR_OUT);
	gpio_pin_configure(dev, LED3, GPIO_DIR_OUT);
}

void leds_write(uint8_t mask, uint8_t value){
	struct device *dev;
	dev = device_get_binding(LED_PORT);
	if ((mask >> 0) & 1) gpio_pin_write(dev, LED0, (value >> 0) & 1);
	if ((mask >> 1) & 1) gpio_pin_write(dev, LED1, (value >> 1) & 1);
	if ((mask >> 2) & 1) gpio_pin_write(dev, LED2, (value >> 2) & 1);
	if ((mask >> 3) & 1) gpio_pin_write(dev, LED3, (value >> 3) & 1);
}
```

## src/sensor.c
```c
#include "sensor.h"
#include "walltime.h"

int sensor_build_payload(u8_t * payload_buf){
    uint64_t timestamp = 0;
    uint64_t accuracy = 0;
    int err;

    // Get wall-time stamp
    err = walltime_get(&timestamp, &accuracy);
    if (err < 0) return -1;

    printk("accuracy(1024ths):%llu\n",accuracy>>22);

    // Recalibrate if inaccurate (>=0.5s)
    if (accuracy>>31 > 0){
        printk("TOO INACCURATE\n");
        err = walltime_calibrate();
        if (err < 0) return -1;
    }

    // Build payload string
    sprintf(payload_buf, "%x %x", (u32_t)(timestamp>>32), (u32_t)(timestamp));

    return 0;
}
```

## src/sntp_raw.c
```c
/*
 * Copyright (c) 2017 Linaro Limited
 * Copyright (c) 2019 Intel Corporation
 *
 * SPDX-License-Identifier: Apache-2.0
 */

#include <logging/log.h>
LOG_MODULE_REGISTER(net_sntp, CONFIG_SNTP_LOG_LEVEL);

#include "sntp_raw.h"
#include "sntp_pkt.h"

#define SNTP_LI_MAX 3
#define SNTP_VERSION_NUMBER 3
#define SNTP_MODE_CLIENT 3
#define SNTP_MODE_SERVER 4
#define SNTP_STRATUM_KOD 0 /* kiss-o'-death */
#define OFFSET_1970_JAN_1 2208988800

static void sntp_pkt_dump(struct sntp_pkt *pkt)
{
	if (!pkt) {
		return;
	}

	NET_DBG("li               %x", LVM_GET_LI(pkt->lvm));
	NET_DBG("vn               %x", LVM_GET_VN(pkt->lvm));
	NET_DBG("mode             %x", LVM_GET_MODE(pkt->lvm));
	NET_DBG("stratum:         %x", pkt->stratum);
	NET_DBG("poll:            %x", pkt->poll);
	NET_DBG("precision:       %x", pkt->precision);
	NET_DBG("root_delay:      %x", pkt->root_delay);
	NET_DBG("root_dispersion: %x", pkt->root_dispersion);
	NET_DBG("ref_id:          %x", pkt->ref_id);
	NET_DBG("ref_tm_s:        %x", pkt->ref_tm_s);
	NET_DBG("ref_tm_f:        %x", pkt->ref_tm_f);
	NET_DBG("orig_tm_s:       %x", pkt->orig_tm_s);
	NET_DBG("orig_tm_f:       %x", pkt->orig_tm_f);
	NET_DBG("rx_tm_s:         %x", pkt->rx_tm_s);
	NET_DBG("rx_tm_f:         %x", pkt->rx_tm_f);
	NET_DBG("tx_tm_s:         %x", pkt->tx_tm_s);
	NET_DBG("tx_tm_f:         %x", pkt->tx_tm_f);
}

static s32_t parse_response(u8_t *data, u16_t len, u32_t orig_ts,
			    u64_t *sntp_time)
{
	struct sntp_pkt *pkt = (struct sntp_pkt *)data;
	u32_t ts;
	u32_t tf;

	sntp_pkt_dump(pkt);

	if (ntohl(pkt->orig_tm_s) != orig_ts) {
		NET_DBG("Mismatch originate timestamp: %d, expect: %d",
			ntohl(pkt->orig_tm_s), orig_ts);
		return -EINVAL;
	}

	if (LVM_GET_MODE(pkt->lvm) != SNTP_MODE_SERVER) {
		/* For unicast and manycast, server should return 4.
		 * For broadcast (which is not supported now), server should
		 * return 5.
		 */
		NET_DBG("Unexpected mode: %d", LVM_GET_MODE(pkt->lvm));
		return -EINVAL;
	}

	if (pkt->stratum == SNTP_STRATUM_KOD) {
		NET_DBG("kiss-o'-death stratum");
		return -EBUSY;
	}

	if (ntohl(pkt->tx_tm_s) == 0 && ntohl(pkt->tx_tm_f) == 0) {
		NET_DBG("zero transmit timestamp");
		return -EINVAL;
	}

	// Reorder tx timestamp to host byte order
	ts = ntohl(pkt->tx_tm_s);
	tf = ntohl(pkt->tx_tm_f);

	// Combine tx seconds and fractions to a single timestamp
	*sntp_time = ( (u64_t)(ts) << 32 ) | (u64_t)(tf) ;

	return 0;
}

static int sntp_recv_response(struct sntp_ctx *sntp, u32_t timeout,
			      u64_t *sntp_time)
{
	struct sntp_pkt buf = { 0 };
	int status;
	int rcvd;

	if (poll(sntp->sock.fds, sntp->sock.nfds, timeout) < 0) {
		NET_ERR("Error in poll:%d", errno);
		return -errno;
	}

	rcvd = recv(sntp->sock.fd, (u8_t *)&buf, sizeof(buf), 0);
	if (rcvd < 0) {
		return -errno;
	}

	if (rcvd != sizeof(struct sntp_pkt)) {
		return -EMSGSIZE;
	}

	status = parse_response((u8_t *)&buf, sizeof(buf),
				sntp->expected_orig_ts,
				sntp_time);
	return status;
}

static u32_t get_uptime_in_sec(void)
{
	u64_t time;

	time = k_uptime_get_32();

	return time / MSEC_PER_SEC;
}

int sntp_init(struct sntp_ctx *ctx, struct sockaddr *addr, socklen_t addr_len)
{
	int ret;

	if (!ctx || !addr) {
		return -EFAULT;
	}

	memset(ctx, 0, sizeof(struct sntp_ctx));

	ctx->sock.fd = socket(addr->sa_family, SOCK_DGRAM, IPPROTO_UDP);
	if (ctx->sock.fd < 0) {
		NET_ERR("Failed to create UDP socket %d", errno);
		return -errno;
	}

	ret = connect(ctx->sock.fd, addr, addr_len);
	if (ret < 0) {
		NET_ERR("Cannot connect to UDP remote : %d", errno);
		return -errno;
	}

	ctx->sock.fds[ctx->sock.nfds].fd = ctx->sock.fd;
	ctx->sock.fds[ctx->sock.nfds].events = POLLIN;
	ctx->sock.nfds++;

	return 0;
}

int sntp_request(struct sntp_ctx *ctx, u32_t timeout, u64_t *sntp_time)
{
	struct sntp_pkt tx_pkt = { 0 };
	int ret = 0;

	if (!ctx || !sntp_time) {
		return -EFAULT;
	}

	/* prepare request pkt */
	LVM_SET_LI(tx_pkt.lvm, 0);
	LVM_SET_VN(tx_pkt.lvm, SNTP_VERSION_NUMBER);
	LVM_SET_MODE(tx_pkt.lvm, SNTP_MODE_CLIENT);
	ctx->expected_orig_ts = get_uptime_in_sec() + OFFSET_1970_JAN_1;
	tx_pkt.tx_tm_s = htonl(ctx->expected_orig_ts);

	ret = send(ctx->sock.fd, (u8_t *)&tx_pkt, sizeof(tx_pkt), 0);
	if (ret < 0) {
		NET_ERR("Failed to send over UDP socket %d", ret);
		return ret;
	}

	return sntp_recv_response(ctx, timeout, sntp_time);
}

void sntp_close(struct sntp_ctx *ctx)
{
	if (ctx) {
		close(ctx->sock.fd);
	}
}
```

## src/walltime.c
```c
#include "walltime.h"
#include "estimator.h"

static struct sntp_ctx ctx;
static struct sockaddr_in ntp_addr;

static tinysync_est_state_t state;
static tinysync_est_ret_t last_result;

// Gets a tiny-sync datapoint by requesting time over SNTP
int get_datapoint(tinysync_datapoint_t * datapoint){
    int rv;

    /* ipv4 ntp*/
    memset(&ntp_addr, 0, sizeof(ntp_addr));

    ntp_addr.sin_family = AF_INET;
    ntp_addr.sin_port = htons(123);
    ntp_addr.sin_addr.s_addr = (u32_t) 0x0602f081; // "129.240.2.6" // ntp.uio.no, UIO's time server

    rv = sntp_init(&ctx, (struct sockaddr *) &ntp_addr,
                sizeof(struct sockaddr_in));
    if (rv < 0) {
        printk("Failed to init sntp ctx: %d", rv);
        return -1;
    }

    datapoint->t_o = k_uptime_get();
    rv = sntp_request(&ctx, K_FOREVER, &(datapoint->t_b) );
    if (rv < 0) {
        printk("Failed to send sntp request: %d", rv);
        return -1;
    }
    datapoint->t_r = k_uptime_get();


    printk("SNTP time: %llx\n", datapoint->t_b);
    printk("status: %d\n", rv);

    sntp_close(&ctx);
    
    return 0;
}

int walltime_calibrate(){
    tinysync_datapoint_t datapoint;
    int err = get_datapoint(&datapoint);
    if (err < 0) return -1;
    last_result = tinysync_est_etimate(&state, &datapoint);
    while(last_result != TINYSYNC_EST_OK){
        k_sleep(K_MSEC(1000));
        int err = get_datapoint(&datapoint);
        if (err < 0) return -1;
        last_result = tinysync_est_etimate(&state, &datapoint);
    }
    return 0;
}

int walltime_get(uint64_t * t_expected, uint64_t * accuracy){
    if (last_result != TINYSYNC_EST_OK) {
        return -1;
    }
    uint64_t now = k_uptime_get();
    uint64_t max_t_2 = (uint64_t)((((double)now) - state.lineset.ba.b) / state.lineset.ba.a);
    uint64_t min_t_2 = (uint64_t)((((double)now) - state.lineset.ab.b) / state.lineset.ab.a);
    *t_expected = (max_t_2/2) + (min_t_2/2);
    *accuracy = (max_t_2/2) - (min_t_2/2);
    //printk("T2EXP:%llx\n", (max_t_2/2) + (min_t_2/2) );
    //printk("ACC (1024ths)(1sec):%lld\n", ((max_t_2/2) - (min_t_2/2)) >> 22 );
    //printk("RESLT:%d\n",result);
    return 0;
}

int walltime_init(){
    tinysync_est_state_t_initialize(&state);
    last_result = TINYSYNC_EST_INVALID;
    int err = walltime_calibrate();
    if (err < 0) return -1;
    return 0;
}
```
